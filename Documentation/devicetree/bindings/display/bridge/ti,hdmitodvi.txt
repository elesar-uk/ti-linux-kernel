## Documentation/devicetree/bindings/display/bridge/ti,hdmitodvi.txt
```
HDMI to DVI encoder
===================

Required properties:
- compatible: "ti,hdmitodvi"

Required nodes:
- Video port 0 for DPI input [1].
- Video port 1 for DVI output [1].

[1]: Documentation/devicetree/bindings/media/video-interfaces.txt

Example
-------

hdmitodvi: encoder@0 {
	compatible = "ti,hdmitodvi";

	ports {
		#address-cells = <1>;
		#size-cells = <0>;

		port@0 {
			reg = <0>;

			hdmitodvi_in: endpoint@0 {
				remote-endpoint = <&hdmi_out>;
			};
		};

		port@1 {
			reg = <1>;

			hdmitodvi_out: endpoint@0 {
				remote-endpoint = <&dvi_connector_in>;
			};
		};
	};
};
```
